## conf/layer.conf
```bitbake
# We have a conf and classes directory, add to BBPATH
BBPATH .= ":${LAYERDIR}"

# We have recipes-* directories, add to BBFILES
BBFILES += "${LAYERDIR}/recipes-*/*/*.bb \
	${LAYERDIR}/recipes-*/*/*.bbappend"

BBFILE_COLLECTIONS += "dunkley"
BBFILE_PATTERN_dunkley = "^${LAYERDIR}/"
BBFILE_PRIORITY_dunkley = "6"
LAYERDEPENDS_dunkley = "core openembedded-layer"
LAYERSERIES_COMPAT_dunkley = "honister"
```

## wic/sdimage-zynqmp.wks
```
# short-description: Create SD card image.
# long-description: Create SD card image with vfat boot partition and ext4 rootfs partition.

part /boot --source bootimg-partition --ondisk mmcblk0 --fstype=vfat --label boot --active --align 4 --size 128
part / --source rootfs --ondisk mmcblk0 --fstype=ext4 --label root --align 4
```
